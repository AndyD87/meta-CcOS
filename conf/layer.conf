## conf/layer.conf
```bitbake
# We have a conf and classes directory, add to BBPATH
LAYERSERIES_COMPAT_meta-ccos = "sumo"

# We have a conf and classes directory, append to BBPATH
BBPATH .= ":${LAYERDIR}"

# We have a packages directory, add to BBFILES
BBFILES += " ${LAYERDIR}/recipes*/*/*.bb \
             ${LAYERDIR}/recipes*/*/*.bbappend"
BBFILE_COLLECTIONS += "meta-ccos"
BBFILE_PATTERN_meta-ccos := "^${LAYERDIR}/"
BBFILE_PRIORITY_meta-ccos := "8"
```

## conf/local.conf
```bitbake
# This file is your local configuration file and is where all local user settings
# are placed. The comments in this file give some guide to the options a new user
# to the system might want to change but pretty much any configuration option can
# be set in this file. More adventurous users can look at local.conf.extended
# which contains other examples of configuration which can be placed in this file
# but new users likely won't need any of them initially.
#
# Lines starting with the '#' character are commented out and in some cases the
# default values are provided as comments to show people example syntax. Enabling
# the option is a question of removing the # character and making any change to the
# variable as required.

MACHINE ??= "genericx86-64"

DL_DIR ?= "${TOPDIR}/../../downloads"

DISTRO ?= "poky"
PACKAGE_CLASSES ?= "package_deb"

EXTRA_IMAGE_FEATURES ?= "debug-tweaks"

USER_CLASSES ?= "buildstats image-mklibs image-prelink"

CONF_VERSION = "1"
```
